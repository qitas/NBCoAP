#include "ov2640api.h"
#include "flash.h"
#include "common.h"
#include "dcmi_ov2640.h"
#include "ir.h"
#include "testpoint.h"

unsigned char* read_imgbuffer(int index  , int *imglen , unsigned int *paizhaotime)
{
	unsigned int program_address;
	switch(index)
	{
		case 0:
			program_address = IMG_CACHE_ADDR_0;
			break;
		case 1:
			program_address = IMG_CACHE_ADDR_1;
			break;
		case 2:
			program_address = IMG_CACHE_ADDR_2;
			break;
		default:
			break;
			
	}
	
	memcpy((unsigned char*)imglen , (unsigned char*)(program_address + 4),4);
	memcpy((unsigned char*)paizhaotime , (unsigned char*)(program_address + 4 + 4),4);
	
	DEBUG_VALUE(*paizhaotime);
	
	//paizhaotime
	return (unsigned char*)(program_address + 12);
	
	return 0x0;
}

const unsigned char JPEG_HEADER_DAT[] =
{
	0xff,0xd8,0xff,0xe0,0x00,0x10,0x4a,0x46,0x49,0x46,0x00,0x01,0x01,0x01,0x00,0x00,
	0x00,0x00,0x00,0x00,0xff,0xdb,0x00,0x43,0x00,0x0c,0x08,0x09,0x0b,0x09,0x08,0x0c,
	0x0b,0x0a,0x0b,0x0e,0x0d,0x0c,0x0e,0x12,0x1e,0x14,0x12,0x11,0x11,0x12,0x25,0x1a,
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	0x15,0x52,0xd1,0xf0,0x24,0x33,0x62,0x72,0x82,0x09,0x0a,0x16,0x17,0x18,0x19,0x1a,
};


static int check_jpeg_format(unsigned char *jpeg)
{
	int i=0;
	for(i=0;i<sizeof(JPEG_HEADER_DAT);i++)
	{
		if (JPEG_HEADER_DAT[i] != jpeg[i])
			return -1;
	}
	
	return 0;
}

#include "rtc.h"
#include "utimer.h"

unsigned int ___paizhaoshijian = 0;
int read_photo_ov2640(int index)
{
	char readcount;
	unsigned char *flashimgdata;
	int ret,tmp,flashimglength;
	unsigned int time;
	
	//增加一个DELAY，让设备准备好
	utimer_sleep(100);
	
	alloc_jpegbuffer();
	
	readcount = 0;
	
	printf("ov2640 poweron.\r\n");
	ov2640_poweron();
	ov2640_flashlight_power(1);
	openIR();
	ret = ov2640_init();
	
	//如果拍照失败了，就先复位
	if(ret < 0)
	{
		printf("READ Photo ERROR!!!!!!!!!!!!!!!!!!!\r\n");
		//__SET_NEXT_WAKEUP_TIM(26);
		sys_shutdown();
	}
	
	
	//摄像头初始化完的前几张可能曝光不稳定所以需要一个delay
	utimer_sleep(1000);
	
	reread:
	readcount ++;
	
  if (ret == 0)
	{
		printf("ov2640 init success .\r\n");
		
		ov2640_checkok();
		
		//for(;;)
		___paizhaoshijian = RTC_GetCounter();
		DEBUG_VALUE(___paizhaoshijian);
		DEBUG_VALUE(__time_100ms_cnt[TIMER_100MS_SYSTEMTIME]*100);
		
		ov2640_read();
	}else{
		printf("ov2640 init failed .\r\n");
	}
	
	printf("ov2640 poweroff.\r\n");
	
	ret = -1;
	//检查图片是否有效
	if((JpegDataCnt > sizeof(JPEG_HEADER_DAT)) && (JpegDataCnt <= JPEG_BUFFER_LENGTH))
	{
		printf("Read pic length %d [%02x%02x] [%02x%02x].\r\n",JpegDataCnt,JpegBuffer[0],JpegBuffer[1],JpegBuffer[JpegDataCnt-2],JpegBuffer[JpegDataCnt-1]);
		
		if (check_jpeg_format(JpegBuffer) >= 0)
		{
			ret = 0;
		}
		else
		{
			//最多重读5次
			if (readcount > 5)
			{
				ret = -1;
			}
			else
			{
				goto reread;
			}
			
		}
		
		#if 0
		if((JpegBuffer[1] == 0xD8) && (JpegBuffer[JpegDataCnt-1] == 0x0))
		{
			ret = 0;
		}
		else
		{
			if (readcount > 5)
			{
				ret = -1;
			}
			else
			{
				goto reread;
			}
		}
		#endif
		
	}else{
		
	}
	
	ov2640_flashlight_power(0);
	closeIR();
	ov2640_poweroff();
	
	
	OVINIT_ERROR:
	

	
	//NVIC_SystemReset();
	
	{
		reg_type5 regt;
		DEBUG_VALUE(JpegDataCnt);
		regt = (reg_type5)((__IO_REG*)(REG_ADDR))[5];regt(index,JpegBuffer,JpegDataCnt);
	}
	
	flashimgdata = read_imgbuffer(index,&flashimglength,&time);
	
	printf("PAIZHAO SHIJIAN %d %d\r\n",___paizhaoshijian,time);
	
	free_jpegbuffer();
	
	return ret;
	
}